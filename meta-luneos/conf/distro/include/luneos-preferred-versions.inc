## meta-luneos/conf/distro/include/luneos-preferred-versions.inc
```bitbake
# Copyright (c) 2012-2014 LG Electronics, Inc.

#
# NOTE: Keep the lists in alphabetical order
#

PREFERRED_VERSION_webruntime ?= "79.%"
#PREFERRED_VERSION_webruntime ?= "68.%"
```
